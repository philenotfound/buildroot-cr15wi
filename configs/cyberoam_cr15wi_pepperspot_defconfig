## configs/cyberoam_cr15wi_pepperspot_defconfig
```kconfig
BR2_x86_c32=y
BR2_TOOLCHAIN_BUILDROOT_GLIBC=y
BR2_TOOLCHAIN_BUILDROOT_CXX=y
BR2_GCC_ENABLE_OPENMP=y
BR2_PACKAGE_HOST_GDB=y
BR2_TARGET_GENERIC_GETTY_PORT="tty1"
BR2_ROOTFS_OVERLAY="board/cyberoam/cr15wi/rootfs-overlay/"
BR2_ROOTFS_POST_IMAGE_SCRIPT="board/cyberoam/cr15wi/postimage.sh"
BR2_LINUX_KERNEL=y
BR2_LINUX_KERNEL_USE_CUSTOM_CONFIG=y
BR2_LINUX_KERNEL_CUSTOM_CONFIG_FILE="board/cyberoam/cr15wi/kernel.config"
BR2_LINUX_KERNEL_INSTALL_TARGET=y
BR2_PACKAGE_BUSYBOX_SHOW_OTHERS=y
BR2_PACKAGE_LSHW=y
BR2_PACKAGE_PCIUTILS=y
BR2_PACKAGE_FREERADIUS=y
BR2_PACKAGE_HOSTAPD=y
BR2_PACKAGE_LIGHTTPD=y
BR2_PACKAGE_LIGHTTPD_OPENSSL=y
BR2_PACKAGE_PEPPERSPOT=y
BR2_TARGET_ROOTFS_EXT2=y
BR2_TARGET_ROOTFS_EXT2_4=y
BR2_TARGET_ROOTFS_EXT2_BLOCKS=24576
BR2_TARGET_ROOTFS_EXT2_RESBLKS=5
# BR2_TARGET_ROOTFS_TAR is not set
BR2_TARGET_GRUB2=y
BR2_TARGET_GRUB2_BUILTIN_MODULES="boot linux ext2 fat part_msdos part_gpt normal biosdisk serial msdospart"
BR2_PACKAGE_HOST_GENIMAGE=y
```

## configs/cyberoam_cr15wi_pepperspot_prebuilt_toolchain_defconfig
```kconfig
BR2_x86_c32=y
BR2_TOOLCHAIN_EXTERNAL=y
BR2_TOOLCHAIN_EXTERNAL_CUSTOM=y
BR2_TOOLCHAIN_EXTERNAL_PATH="i686-cyberoam_cr15wi-linux-gnu/usr"
BR2_TOOLCHAIN_EXTERNAL_CUSTOM_PREFIX="i686-cyberoam_cr15wi-linux-gnu"
BR2_TOOLCHAIN_EXTERNAL_HEADERS_3_16=y
BR2_TOOLCHAIN_EXTERNAL_CUSTOM_GLIBC=y
BR2_TOOLCHAIN_EXTERNAL_CXX=y
BR2_PACKAGE_HOST_GDB=y
BR2_TARGET_GENERIC_GETTY_PORT="tty1"
BR2_ROOTFS_OVERLAY="board/cyberoam/cr15wi/rootfs-overlay/"
BR2_ROOTFS_POST_BUILD_SCRIPT="board/cyberoam/cr15wi/postbuild.sh"
BR2_ROOTFS_POST_IMAGE_SCRIPT="board/cyberoam/cr15wi/postimage.sh"
BR2_LINUX_KERNEL=y
BR2_LINUX_KERNEL_USE_CUSTOM_CONFIG=y
BR2_LINUX_KERNEL_CUSTOM_CONFIG_FILE="board/cyberoam/cr15wi/kernel.config"
BR2_LINUX_KERNEL_INSTALL_TARGET=y
BR2_PACKAGE_BUSYBOX_CONFIG="board/cyberoam/cr15wi/busybox.config"
BR2_PACKAGE_BUSYBOX_SHOW_OTHERS=y
BR2_PACKAGE_FLEX=y
BR2_PACKAGE_LINUX_FIRMWARE=y
BR2_PACKAGE_LINUX_FIRMWARE_RALINK_RT2XX=y
BR2_PACKAGE_PCIUTILS=y
BR2_PACKAGE_PERL=y
BR2_PACKAGE_OPENSSL_BIN=y
BR2_PACKAGE_LIBTALLOC=y
BR2_PACKAGE_NCURSES=y
BR2_PACKAGE_PCRE=y
BR2_PACKAGE_DNSMASQ=y
# BR2_PACKAGE_DNSMASQ_TFTP is not set
# BR2_PACKAGE_DNSMASQ_DHCP is not set
BR2_PACKAGE_DROPBEAR=y
BR2_PACKAGE_HOSTAPD=y
BR2_PACKAGE_IPTABLES=y
BR2_PACKAGE_LIGHTTPD=y
BR2_PACKAGE_LIGHTTPD_OPENSSL=y
BR2_PACKAGE_WIRELESS_TOOLS=y
BR2_PACKAGE_WIRELESS_TOOLS_LIB=y
BR2_TARGET_ROOTFS_EXT2=y
BR2_TARGET_ROOTFS_EXT2_4=y
BR2_TARGET_ROOTFS_EXT2_BLOCKS=65536
BR2_TARGET_ROOTFS_EXT2_RESBLKS=5
# BR2_TARGET_ROOTFS_TAR is not set
BR2_TARGET_GRUB2=y
BR2_TARGET_GRUB2_BUILTIN_MODULES="boot linux ext2 fat part_msdos part_gpt normal biosdisk serial msdospart"
BR2_PACKAGE_HOST_GENIMAGE=y
```

## configs/cyberoam_cr15wi_toolchain_only_defconfig
```kconfig
BR2_x86_c32=y
BR2_HOST_DIR="$(TOPDIR)/i686-cyberoam_cr15wi-linux-gnu"
BR2_TOOLCHAIN_BUILDROOT_VENDOR="cyberoam_cr15wi"
BR2_TOOLCHAIN_BUILDROOT_GLIBC=y
BR2_TOOLCHAIN_BUILDROOT_CXX=y
BR2_GCC_ENABLE_OPENMP=y
BR2_PACKAGE_HOST_GDB=y
BR2_INIT_NONE=y
# BR2_PACKAGE_BUSYBOX is not set
# BR2_TARGET_ROOTFS_TAR is not set
```

## package/freeradius/Config.in
```kconfig
config BR2_PACKAGE_FREERADIUS
	bool "freeradius"
	select BR2_PACKAGE_OPENSSL
	select BR2_PACKAGE_LIBTALLOC
	depends on BR2_TOOLCHAIN_HAS_THREADS # libusb
	depends on BR2_USE_WCHAR
	depends on BR2_USE_MMU # fork()
	help
	  freeradius foo

	  http://freeradius.org

comment "freeradius needs a toolchain w/ threads, wchar"
	depends on !BR2_TOOLCHAIN_HAS_THREADS || !BR2_USE_WCHAR
	depends on BR2_USE_MMU
```

## package/libtalloc/Config.in
```kconfig
config BR2_PACKAGE_LIBTALLOC
	bool "libtalloc"
	help
	  talloc is a hierarchical, reference counted memory pool system with destructors. It is the core memory allocator used in Samba.

	  https://talloc.samba.org/talloc/doc/html/index.html
```

## package/pepperspot/Config.in
```kconfig
config BR2_PACKAGE_PEPPERSPOT
	bool "pepperspot"
	depends on BR2_TOOLCHAIN_HAS_THREADS
	depends on BR2_USE_WCHAR
	depends on BR2_USE_MMU # fork()
	depends on BR2_FREERADIUS
	help
	  PepperSpot is a captive portal or wireless LAN access point controller which support the IPv6 protocol. It supports web based login and it supports Wireless Protected Access (WPA). Authentication is handled by your favorite radius server (over IPv4/IPv6).

	  http://pepperspot.sourceforge.net

comment "freeradius needs a toolchain w/ threads, wchar"
	depends on !BR2_TOOLCHAIN_HAS_THREADS || !BR2_USE_WCHAR
	depends on BR2_USE_MMU
```
